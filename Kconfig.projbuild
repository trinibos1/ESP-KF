## Kconfig.projbuild
```kconfig
source "components/espkm_core/Kconfig"
source "components/espkm_drivers/Kconfig"
source "components/espkm_router/Kconfig"
source "components/espkm_usb/Kconfig"
source "components/espkm_ble/Kconfig"
```

## components/espkm_ble/Kconfig
```kconfig
menu "ESPKM BLE"

config ESPKM_BLE_ENABLE
    bool "Enable BLE (scaffold)"
    default y

config ESPKM_BLE_TASK_STACK
    int "ble_task stack (bytes)"
    default 4096
    depends on ESPKM_BLE_ENABLE

config ESPKM_BLE_TASK_PRIO
    int "ble_task priority"
    default 7
    depends on ESPKM_BLE_ENABLE

config ESPKM_BLE_DEVICE_NAME
    string "BLE device name"
    default "espkm-hid2"
    depends on ESPKM_BLE_ENABLE

config ESPKM_BLE_MANUFACTURER
    string "BLE DIS manufacturer name"
    default "Espressif"
    depends on ESPKM_BLE_ENABLE

config ESPKM_BLE_MODEL
    string "BLE DIS model number"
    default "espkm-v2"
    depends on ESPKM_BLE_ENABLE

endmenu
```

## components/espkm_cli/Kconfig
```kconfig
menu "ESPKM CLI"

config ESPKM_CLI_ENABLE
    bool "Enable interactive CLI (espkm> prompt)"
    default y
    help
        Enable the esp_console based REPL exposing the "stats", "transport",
        "ring", "pins", and "ble" commands on the stdio console.
        Disable to save flash/RAM or for production builds.

endmenu
```

## components/espkm_core/Kconfig
```kconfig
menu "ESPKM"

config ESPKM_EVENT_QUEUE_LEN
    int "eventQueue length"
    default 64
    range 8 256
    help
        Queue length for debounced KeyEvent items.

config ESPKM_REPORT_QUEUE_LEN
    int "reportQueue length (use 1 for overwrite)"
    default 1
    range 1 16
    help
        Report queue length. Use 1 to enable overwrite/mailbox semantics.

config ESPKM_CORE_TASK_STACK
    int "core_task stack (bytes)"
    default 8192

config ESPKM_CORE_TASK_PRIO
    int "core_task priority"
    default 10

config ESPKM_MATRIX_TASK_STACK
    int "matrix_task stack (bytes)"
    default 4096

config ESPKM_MATRIX_TASK_PRIO
    int "matrix_task priority"
    default 11

config ESPKM_MATRIX_SCAN_PERIOD_MS
    int "Matrix scan period (ms, max 1kHz)"
    default 1
    range 1 10

choice ESPKM_TAPHOLD_POLICY
    prompt "Tap/Hold policy"
    default ESPKM_TAPHOLD_P1_INTERRUPT_HOLD

config ESPKM_TAPHOLD_P1_INTERRUPT_HOLD
    bool "P1 Interrupt = HOLD (default)"

config ESPKM_TAPHOLD_P2_PERMISSIVE
    bool "P2 QMK-like permissive"
endchoice

config ESPKM_P2_PERMISSIVE_HOLD
    bool "P2: permissive_hold"
    default y
    depends on ESPKM_TAPHOLD_P2_PERMISSIVE

config ESPKM_P2_IGNORE_MOD_TAP_INTERRUPT
    bool "P2: ignore_mod_tap_interrupt"
    default n
    depends on ESPKM_TAPHOLD_P2_PERMISSIVE

config ESPKM_P2_RETRO_TAP
    bool "P2: retro_tap"
    default n
    depends on ESPKM_TAPHOLD_P2_PERMISSIVE

config ESPKM_TAPPING_TERM_MS
    int "Default tapping term (ms)"
    default 200
    range 50 500

config ESPKM_COMBO_TERM_MS
    int "Default combo term (ms)"
    default 50
    range 10 200

config ESPKM_DEBUG
    bool "Enable debug ring buffer"
    default y

config ESPKM_DEBUG_RING_LEN
    int "Debug ring entries"
    default 128
    range 32 1024
    depends on ESPKM_DEBUG

config ESPKM_STATS_LOG_PERIOD_MS
    int "Stats log period (ms, 0=off)"
    default 0
    range 0 60000
    help
        If >0, periodically logs internal counters (queue drops, report overwrites, transport state).

config ESPKM_VERBOSE_LOG
    bool "Verbose per-event logging (matrix edges, reports, routing, BLE notifies)"
    default y
    help
        When disabled, the per-event ESP_LOGI lines in matrix_direct,
        core_task, router_task, and the BLE report sender are compiled out.
        Leave on while bringing up new hardware; turn off for normal use.

endmenu
```

## components/espkm_drivers/Kconfig
```kconfig
menu "ESPKM Drivers"

config ESPKM_DIRECT_MATRIX
    bool "Enable direct-pin matrix driver"
    default y

config ESPKM_MATRIX_ROWS
    int "Matrix rows"
    default 2
    range 1 8
    depends on ESPKM_DIRECT_MATRIX

config ESPKM_MATRIX_COLS
    int "Matrix cols"
    default 3
    range 1 16
    depends on ESPKM_DIRECT_MATRIX

config ESPKM_DIRECT_ROW_PINS
    string "Row GPIOs (comma-separated, e.g. 1,2)"
    default "1,2"
    depends on ESPKM_DIRECT_MATRIX

config ESPKM_DIRECT_COL_PINS
    string "Col GPIOs (comma-separated, e.g. 3,4,5)"
    default "3,4,5"
    depends on ESPKM_DIRECT_MATRIX

endmenu
```

## components/espkm_router/Kconfig
```kconfig
menu "ESPKM Router"

config ESPKM_ROUTER_TASK_STACK
    int "router_task stack (bytes)"
    default 4096

config ESPKM_ROUTER_TASK_PRIO
    int "router_task priority"
    default 9

endmenu
```

## components/espkm_usb/Kconfig
```kconfig
menu "ESPKM USB"

config ESPKM_USB_OTG_ENABLE
    bool "Enable USB-OTG (TinyUSB) HID+CDC"
    default n
    help
        Enable TinyUSB-based USB-OTG device (HID keyboard + CDC console).
        On some ESP32-S3 boards the internal USB PHY is routed to USB Serial/JTAG by default,
        so OTG may not enumerate unless the board supports it (or eFuses are changed).

config ESPKM_USB_ENABLE
    bool "Enable USB HID keyboard"
    default y
    depends on ESPKM_USB_OTG_ENABLE

config ESPKM_USB_TASK_STACK
    int "usb_task stack (bytes)"
    default 4096
    depends on ESPKM_USB_ENABLE

config ESPKM_USB_TASK_PRIO
    int "usb_task priority"
    default 8
    depends on ESPKM_USB_ENABLE

config ESPKM_USB_POLL_MS
    int "USB send poll interval (ms)"
    default 1
    range 1 10
    depends on ESPKM_USB_ENABLE

endmenu
```

## sdkconfig.defaults
```kconfig
# =============================================================================
# espkm sdkconfig.defaults
# Target: ESP32-S3 (ProS3D, 16MB flash, internal USB PHY)
# =============================================================================

# -----------------------------------------------------------------------------
# FreeRTOS
# -----------------------------------------------------------------------------
CONFIG_FREERTOS_HZ=1000

# -----------------------------------------------------------------------------
# Flash
# ProS3D ships with 16MB flash; match image header to avoid boot warnings.
# If you move to a 2MB/4MB module later, change this in `idf.py menuconfig`.
# -----------------------------------------------------------------------------
CONFIG_ESPTOOLPY_FLASHSIZE="16MB"
CONFIG_ESPTOOLPY_FLASHSIZE_16MB=y

# -----------------------------------------------------------------------------
# Console — UART0 (TX=GPIO43, RX=GPIO44 on standard S3 boards)
# USB Serial/JTAG is DISABLED so TinyUSB can own the USB PHY.
# On ESP32-S3 USB Serial/JTAG and USB OTG share the same physical pins
# (GPIO19/GPIO20) and the same internal PHY — they cannot coexist.
# Connect a USB-serial adapter to UART0 to use the espkm> console.
# -----------------------------------------------------------------------------
CONFIG_ESP_CONSOLE_UART_DEFAULT=y
CONFIG_ESP_CONSOLE_UART_NUM=0
# CONFIG_ESP_CONSOLE_USB_SERIAL_JTAG is not set
# CONFIG_ESP_CONSOLE_USB_CDC is not set

# -----------------------------------------------------------------------------
# USB OTG — TinyUSB HID keyboard
# TinyUSB owns the USB PHY exclusively (see console note above).
# -----------------------------------------------------------------------------
CONFIG_ESPKM_USB_OTG_ENABLE=y
CONFIG_TINYUSB_HID_COUNT=1
# CONFIG_TINYUSB_CDC_ENABLED is not set
CONFIG_TINYUSB_TASK_ENABLE=n
CONFIG_ESPKM_USB_POLL_MS=1

# -----------------------------------------------------------------------------
# BLE (NimBLE)
# -----------------------------------------------------------------------------
CONFIG_BT_ENABLED=y
CONFIG_BT_NIMBLE_ENABLED=y
CONFIG_BT_NIMBLE_50_FEATURE_SUPPORT=n
CONFIG_BT_NIMBLE_NVS_PERSIST=y
CONFIG_BT_NIMBLE_ATT_PREFERRED_MTU=512
CONFIG_BT_NIMBLE_MSYS_1_BLOCK_COUNT=32
CONFIG_BT_NIMBLE_MSYS_1_BLOCK_SIZE=512
CONFIG_BT_NIMBLE_MAX_CONNECTIONS=3

# -----------------------------------------------------------------------------
# Stats
# 0 = disabled (use `stats` console command on demand instead)
# -----------------------------------------------------------------------------
CONFIG_ESPKM_STATS_LOG_PERIOD_MS=0

CONFIG_ESP_CONSOLE_SECONDARY_NONE=y
# CONFIG_USJ_ENABLE_USB_SERIAL_JTAG is not set
```
